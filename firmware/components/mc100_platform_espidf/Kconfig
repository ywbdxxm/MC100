## firmware/components/mc100_platform_espidf/Kconfig
```kconfig
menu "MC100 V1 platform"
    config MC100_PDM_RIGHT_SLOT
        bool "EVT: use right PDM slot instead of initial left candidate"
        default n
        help
            SELECT is grounded; the effective slot remains an H02 measurement.
    config MC100_SD_CD_ACTIVE_HIGH
        bool "EVT: SD card detect active high"
        default n
        help
            Low-active is the unverified H01 candidate. This does not change wiring.
endmenu
```

## firmware/main/Kconfig.projbuild
```kconfig
menu "MC100 application"

config MC100_APP_PRODUCT
    bool "Use the autonomous product recording loop"
    default y
    help
        Select the minimal autonomous recorder product. The default product
        initializes the board and SD card, records 16 kHz mono PCM for the
        configured product duration, and then stops in IDLE. Disable this
        option for the EVT_USB_BENCH diagnostic application; that mode is
        intended for explicit bench builds and does not provide autonomous
        recording.

config MC100_LEGACY_RUNTIME
    bool "Build the legacy Supervisor product runtime"
    default n
    depends on MC100_APP_PRODUCT
    help
        Retain the pre-V1 Supervisor, battery, VAD, and recovery runtime for
        migration and bench validation. The minimal product recorder remains
        the default when this option is disabled.

endmenu
```
